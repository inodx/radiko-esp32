## components/atomecho_board/Kconfig.projbuild
```kconfig
menu "ATOMECHO"

choice ATOMECHO_AUDIO_BOARD
    prompt "ATOMECHO audio board"
    default ATOMECHO_BOARD_V1_0
    help
        Select an audio board to use with the ESP-ADF

config ATOMECHO_BOARD_V1_0
    bool "ATOMECHO board v1.0"

endchoice

endmenu
```

## components/radiko-esp32/Kconfig.projbuild
```kconfig
menu "Radiko Configuration"

config AUTH_KEY
    string "auth key"
	default ""
	help
		Input the auth key(Required)

endmenu
```

## main/Kconfig.projbuild
```kconfig
menu "Example Configuration"

config WIFI_SSID
    string "WiFi SSID"
	default "myssid"
	help
		SSID (network name) for the example to connect to.

config WIFI_PASSWORD
    string "WiFi Password"
	default "mypassword"
	help
		WiFi password (WPA or WPA2) for the example to use.

		Can be left blank if the network has no security set.

endmenu

menu "Output Configuration"

choice PLAY_MP3_OUTPUT_TYPE
    prompt "Select play mp3 output"
    default PLAY_OUTPUT_DAC
    help
        Select play output method

config PLAY_OUTPUT_DAC
    bool "Enable DAC output"

config PLAY_OUTPUT_PWM
    bool "Enable PWM output"

endchoice

config PWM_RIGHT_OUTPUT_GPIO_NUM
    int "PWM Stream Right Output GPIO NUM"
    default 18
    depends on PLAY_OUTPUT_PWM
    help
        GPIO number to use for PWM stream driver.

config PWM_LEFT_OUTPUT_GPIO_NUM
    int "PWM Stream Left Output GPIO NUM"
    default 23
    depends on PLAY_OUTPUT_PWM
    help
        GPIO number to use for PWM stream driver.

endmenu
```
